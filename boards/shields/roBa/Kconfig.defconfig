## boards/shields/roBa/Kconfig.defconfig
```kconfig
if SHIELD_ROBA_R

config ZMK_KEYBOARD_NAME
    default "roBa_R"

config ZMK_SPLIT
    default y

config ZMK_SPLIT_ROLE_CENTRAL
    default y

config ZMK_KEYMAP
    string
    default "roBa_R"

endif

if SHIELD_ROBA_L

config ZMK_KEYBOARD_NAME
    default "roBa_L"

config ZMK_SPLIT
    default y

config ZMK_KEYMAP
    string
    default "roBa_L"

endif

if SHIELD_ROBA_DONGLE

config ZMK_KEYBOARD_NAME
    default "roBa_dongle"

# keymapは無し（空）
config ZMK_KEYMAP
    string
    default ""

endif
```

## config/west.yml
```yaml
manifest:
  remotes:
    - name: zmkfirmware
      url-base: https://github.com/petejohanson
    - name: kumamuk-git
      url-base: https://github.com/kumamuk-git
    - name: caksoylar  # <-- new entry
      url-base: https://github.com/caksoylar  
    - name: kot149
      url-base: https://github.com/kot149
  projects:
    - name: zmk
      remote: zmkfirmware
      revision: v0.2.1
      import: app/west.yml
    - name: zmk-pmw3610-driver
      remote: kumamuk-git
      revision: main
    - name: zmk-rgbled-widget  # <-- new entry
      remote: caksoylar
      revision: main
    - name: zmk-layout-shift
      remote: kot149
      revision: v1
  self:
    path: config
```
